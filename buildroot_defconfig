## buildroot_defconfig
```kconfig
# adopted from configs/pc_x86_64_bios_defconfig

# Architecture
BR2_x86_64=y

# System
BR2_TARGET_GENERIC_GETTY_PORT="tty1"
BR2_SYSTEM_DHCP="eth0"

# Required tools to create bootable media
BR2_PACKAGE_HOST_GENIMAGE=y

# Bootloader
BR2_TARGET_GRUB2=y

# Image
BR2_TARGET_ROOTFS_EXT2=y
BR2_TARGET_ROOTFS_EXT2_4=y
BR2_TARGET_ROOTFS_EXT2_SIZE="550M"
# BR2_TARGET_ROOTFS_TAR is not set
BR2_ROOTFS_POST_BUILD_SCRIPT="$(BR2_EXTERNAL_CONTAINERS_PATH)/post_build.sh"
BR2_ROOTFS_POST_FAKEROOT_SCRIPT="$(BR2_EXTERNAL_CONTAINERS_PATH)/post_fakeroot.sh"
BR2_ROOTFS_POST_IMAGE_SCRIPT="support/scripts/genimage.sh"
BR2_ROOTFS_POST_SCRIPT_ARGS="-c $(BR2_EXTERNAL_CONTAINERS_PATH)/genimage-bios.cfg"

# Linux headers same as kernel, a 5.13 series
BR2_PACKAGE_HOST_LINUX_HEADERS_CUSTOM_5_13=y

# Kernel
BR2_LINUX_KERNEL=y
BR2_LINUX_KERNEL_CUSTOM_VERSION=y
BR2_LINUX_KERNEL_CUSTOM_VERSION_VALUE="5.13.16"
BR2_LINUX_KERNEL_USE_CUSTOM_CONFIG=y
BR2_LINUX_KERNEL_CUSTOM_CONFIG_FILE="$(BR2_EXTERNAL_CONTAINERS_PATH)/linux.config"
BR2_LINUX_KERNEL_INSTALL_TARGET=y
BR2_LINUX_KERNEL_NEEDS_HOST_OPENSSL=y

# Firmware
# BR2_PACKAGE_LINUX_FIRMWARE is not set

#######################################################################

BR2_ROOTFS_OVERLAY="$(BR2_EXTERNAL_CONTAINERS_PATH)/rootfs-overlay"

BR2_CCACHE=y

BR2_PACKAGE_E2FSPROGS=y
BR2_PACKAGE_CA_CERTIFICATES=y
BR2_PACKAGE_OPENSSH=y

# Img
BR2_PACKAGE_E2FSPROGS_RESIZE2FS=y

# Init
BR2_TOOLCHAIN_BUILDROOT_MUSL=y
BR2_SSP_NONE=y
BR2_INIT_OPENRC=y

# Containerd
BR2_PACKAGE_CONTAINERD=y
BR2_PACKAGE_BUILDKIT=y
BR2_PACKAGE_CNI_PLUGINS=y
BR2_PACKAGE_LIBSECCOMP=y
BR2_PACKAGE_NERDCTL=y

# Python
BR2_PACKAGE_PYTHON3=y
BR2_PACKAGE_PYTHON3_PYEXPAT=y
BR2_PACKAGE_HOST_PYTHON3=y
BR2_PACKAGE_PYTHON_SETUPTOOLS=y
BR2_PACKAGE_PYTHON_SIX=y

# Lima
BR2_PACKAGE_CLOUD_INIT=y
BR2_PACKAGE_SUDO=y
BR2_PACKAGE_SSHFS=y
BR2_PACKAGE_SHADOW=y

# Networking
BR2_PACKAGE_IPTABLES=y
BR2_PACKAGE_EBTABLES=y
BR2_PACKAGE_ETHTOOL=y
BR2_PACKAGE_SOCAT=y
BR2_PACKAGE_CONNTRACK_TOOLS=y
BR2_PACKAGE_UTIL_LINUX=y
BR2_PACKAGE_UTIL_LINUX_NSENTER=y
BR2_PACKAGE_BRIDGE_UTILS=y
BR2_PACKAGE_IPSET=y

# Miscellanous
BR2_PACKAGE_PSMISC=y
BR2_PACKAGE_BASH=y
```

## external/package/Config.in
```kconfig
menu "Containers"
    source "$BR2_EXTERNAL_CONTAINERS_PATH/package/nerdctl/Config.in"
    source "$BR2_EXTERNAL_CONTAINERS_PATH/package/buildkit/Config.in"
    source "$BR2_EXTERNAL_CONTAINERS_PATH/package/cni-plugins/Config.in"
    source "$BR2_EXTERNAL_CONTAINERS_PATH/package/cni-isolation/Config.in"
    source "$BR2_EXTERNAL_CONTAINERS_PATH/package/shadow/Config.in"
    source "$BR2_EXTERNAL_CONTAINERS_PATH/package/slirp4netns/Config.in"
    source "$BR2_EXTERNAL_CONTAINERS_PATH/package/rootlesskit/Config.in"
    source "$BR2_EXTERNAL_CONTAINERS_PATH/package/cloud-init/Config.in"
    source "$BR2_EXTERNAL_CONTAINERS_PATH/package/python3-configobj/Config.in"
    source "$BR2_EXTERNAL_CONTAINERS_PATH/package/python-jsonpatch/Config.in"
    source "$BR2_EXTERNAL_CONTAINERS_PATH/package/python-jsonpointer/Config.in"
    source "$BR2_EXTERNAL_CONTAINERS_PATH/package/cloud-utils/Config.in"
endmenu
```

## external/package/buildkit/Config.in
```kconfig
config BR2_PACKAGE_BUILDKIT
	bool "buildkit"
	depends on BR2_PACKAGE_HOST_GO_TARGET_ARCH_SUPPORTS
	depends on BR2_PACKAGE_HOST_GO_TARGET_CGO_LINKING_SUPPORTS
	depends on BR2_TOOLCHAIN_HAS_THREADS
	help
	  Build toolkit for container images

	  https://github.com/moby/buildkit

comment "buildkit needs a glibc or musl toolchain w/ threads"
	depends on BR2_PACKAGE_HOST_GO_TARGET_ARCH_SUPPORTS
	depends on BR2_PACKAGE_HOST_GO_TARGET_CGO_LINKING_SUPPORTS
	depends on BR2_USE_MMU
	depends on !BR2_TOOLCHAIN_HAS_THREADS || BR2_TOOLCHAIN_USES_UCLIBC
```

## external/package/cloud-init/Config.in
```kconfig
config BR2_PACKAGE_CLOUD_INIT
	bool "cloud-init"
	depends on BR2_PACKAGE_PYTHON3
	select BR2_PACKAGE_PYTHON_JINJA2 # runtime
	select BR2_PACKAGE_PYTHON_OAUTHLIB # runtime
	select BR2_PACKAGE_PYTHON3_CONFIGOBJ # runtime
	select BR2_PACKAGE_PYTHON_PYYAML # runtime
	select BR2_PACKAGE_PYTHON_REQUESTS # runtime
	select BR2_PACKAGE_PYTHON_URLLIB3 # runtime
	select BR2_PACKAGE_PYTHON_JSONSCHEMA # runtime
	select BR2_PACKAGE_PYTHON_JSONPATCH # runtime
	select BR2_PACKAGE_PYTHON_JSONPOINTER # runtime
	select BR2_PACKAGE_PYTHON_NETIFACES # runtime
	help
	  The standard for customising cloud instances

	  https://cloud-init.io/
```

## external/package/cloud-utils/Config.in
```kconfig
config BR2_PACKAGE_CLOUD_UTILS
	bool "cloud-utils"
	help
	  A useful set of utilities for interacting with a cloud

	  https://github.com/canonical/cloud-utils
```

## external/package/cni-isolation/Config.in
```kconfig
config BR2_PACKAGE_CNI_ISOLATION
	bool "cni-isolation"
	depends on BR2_PACKAGE_HOST_GO_TARGET_ARCH_SUPPORTS
	help
          CNI Bridge Isolation Plugin

          https://github.com/AkihiroSuda/cni-isolation
```

## external/package/python-jsonpatch/Config.in
```kconfig
config BR2_PACKAGE_PYTHON_JSONPATCH
	bool "python-jsonpatch"
        select BR2_PACKAGE_PYTHON_JSONPOINTER # runtime
	help
          Library to apply JSON Patches according to RFC 6902.

	  https://github.com/stefankoegl/python-json-patch
```

## external/package/python-jsonpointer/Config.in
```kconfig
config BR2_PACKAGE_PYTHON_JSONPOINTER
	bool "python-jsonpointer"
	help
          Library to resolve JSON Pointers according to RFC 6901.

	  https://github.com/stefankoegl/python-json-pointer
```

## external/package/python3-configobj/Config.in
```kconfig
config BR2_PACKAGE_PYTHON3_CONFIGOBJ
	bool "python3-configobj"
	select BR2_PACKAGE_PYTHON_SIX # runtime
	help
	  ConfigObj is a simple but powerful config file reader and
	  writer: an ini file round tripper. Its main feature is that
	  it is very easy to use, with a straightforward programmer's
	  interface and a simple syntax for config files.

	  http://www.voidspace.org.uk/python/configobj.html
```

## external/package/python3-requests/Config.in
```kconfig
config BR2_PACKAGE_PYTHON3_REQUESTS
	bool "python3-requests"
	depends on BR2_PACKAGE_PYTHON3 # python-idna
	select BR2_PACKAGE_PYTHON_CERTIFI # runtime
	select BR2_PACKAGE_PYTHON_CHARSET_NORMALIZER # runtime
	select BR2_PACKAGE_PYTHON_IDNA # runtime
	select BR2_PACKAGE_PYTHON_URLLIB3 # runtime
	select BR2_PACKAGE_PYTHON3_SSL # runtime
	select BR2_PACKAGE_PYTHON3_ZLIB # runtime
	help
	  Requests is an Apache2 Licensed HTTP library, written in
	  Python, for human beings.

	  http://www.python-requests.org/
```

## external/package/rootlesskit/Config.in
```kconfig
config BR2_PACKAGE_ROOTLESSKIT
	bool "rootlesskit"
	depends on BR2_PACKAGE_HOST_GO_TARGET_ARCH_SUPPORTS
	depends on BR2_PACKAGE_HOST_GO_TARGET_CGO_LINKING_SUPPORTS
	depends on BR2_TOOLCHAIN_HAS_THREADS
	select BR2_PACKAGE_TUNCTL # runtime
	help
	  Linux-native "fake root" for implementing rootless containers

	  https://github.com/rootless-containers/rootlesskit

comment "rootlesskit needs a glibc or musl toolchain w/ threads"
	depends on BR2_PACKAGE_HOST_GO_TARGET_ARCH_SUPPORTS
	depends on BR2_PACKAGE_HOST_GO_TARGET_CGO_LINKING_SUPPORTS
	depends on BR2_USE_MMU
	depends on !BR2_TOOLCHAIN_HAS_THREADS || BR2_TOOLCHAIN_USES_UCLIBC
```

## external/package/shadow/Config.in
```kconfig
config BR2_PACKAGE_SHADOW
	bool "shadow"
	help
	  Shadow password file utilities for Linux

	  https://github.com/shadow-maint/shadow

if BR2_PACKAGE_SHADOW

config BR2_PACKAGE_SHADOW_PROGS
	bool "install all programs"

endif
```

## external/package/slirp4netns/Config.in
```kconfig
config BR2_PACKAGE_SLIRP4NETNS
	bool "slirp4netns"
        depends on BR2_PACKAGE_LIBSECCOMP_ARCH_SUPPORTS # libseccomp
	select BR2_PACKAGE_LIBGLIB2
        select BR2_PACKAGE_SLIRP
        select BR2_PACKAGE_LIBCAP
        select BR2_PACKAGE_LIBSECCOMP
	help
          User-mode networking for unprivileged network namespaces

          https://github.com/rootless-containers/slirp4netns
```
